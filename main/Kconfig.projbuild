## main/Kconfig.projbuild
```kconfig
menu "ESP-KVM"

    orsource "$IDF_PATH/examples/common_components/env_caps/$IDF_TARGET/Kconfig.env_caps"

    menu "Features"
        comment "Disabled features cost no flash and no RAM."

        config KVM_ENABLE_H264
            bool "H.264 video encoding (hardware)"
            default y
            help
                Pull in the esp_h264 component and offer H.264 as a stream codec.
                Availability is probed at boot (chip revision, encoder open) and
                falls back to MJPEG when the hardware encoder cannot be used.

        config KVM_ENABLE_MSC
            bool "Virtual media (USB mass storage from microSD)"
            default y
            help
                Expose a disk image stored on the microSD card to the target
                machine as a USB CD-ROM or removable drive. Adds TinyUSB MSC and
                SDMMC/FATFS to the image.

        config KVM_ENABLE_ATX
            bool "ATX power control (GPIO)"
            default y
            help
                Drive the target's power and reset headers through optocouplers
                and read its power/HDD LEDs.

        config KVM_ENABLE_AUDIO
            bool "HDMI audio capture (I2S)"
            default n
            help
                Capture the I2S audio the TC358743 extracts from HDMI and stream
                it to the browser. Requires BCLK/LRCK/DATA wired from the capture
                board to the ESP32-P4.

        config KVM_ENABLE_DISPLAY
            bool "Status display (I2C OLED / round SPI LCD)"
            default y
            help
                Drive a small status display that shows the device's IP, link,
                capture status and health. Two kinds are supported: an I2C OLED
                (SSD1306/SH1106/SSD1315) that shares the capture chip's I2C bus
                and is auto-detected with no dedicated pins, or sits on a bus of
                its own where a board has one; and a round colour SPI LCD
                (GC9A01, e.g. the Waveshare 1.28"), which needs the SPI pins set
                below. Off unless switched on in settings, and it does nothing
                when no panel is connected, so it is safe to build into every board.

        config KVM_GC9A01_SPI_HOST
            int "Round SPI LCD (GC9A01) SPI host (2 = SPI2)"
            depends on KVM_ENABLE_DISPLAY
            default 2
            help
                SPI peripheral index for the round GC9A01 LCD. Only used when the
                display type is GC9A01.

        # The panel's five GPIOs stay runtime settings - the operator solders the
        # wires and picks the pins in the console. These only choose what the
        # console offers before anyone touches them, per board, because "free" is
        # a different set of pins on every one of them. A device that has already
        # been configured keeps what it was given: a default is only consulted
        # when nothing is stored.
        config KVM_DISP_SCLK_GPIO
            int "Round LCD default SCLK GPIO"
            depends on KVM_ENABLE_DISPLAY
            range -1 ENV_GPIO_RANGE_MAX
            default 20

        config KVM_DISP_MOSI_GPIO
            int "Round LCD default MOSI GPIO"
            depends on KVM_ENABLE_DISPLAY
            range -1 ENV_GPIO_RANGE_MAX
            default 21

        config KVM_DISP_CS_GPIO
            int "Round LCD default CS GPIO"
            depends on KVM_ENABLE_DISPLAY
            range -1 ENV_GPIO_RANGE_MAX
            default 22

        config KVM_DISP_DC_GPIO
            int "Round LCD default DC GPIO"
            depends on KVM_ENABLE_DISPLAY
            range -1 ENV_GPIO_RANGE_MAX
            default 26
            help
                Not 45 on the Function EV board: that pin carries SD_PWRn, so a
                panel wired there never sees a clean level and stays dark, with
                nothing in the log to say why.

        config KVM_DISP_RST_GPIO
            int "Round LCD default RST GPIO"
            depends on KVM_ENABLE_DISPLAY
            range -1 ENV_GPIO_RANGE_MAX
            default 33

        # An I2C OLED normally shares the capture chip's bus and needs no pins.
        # A board whose OLED socket is a bus of its own - the Grove port on the
        # M5Stack Unit PoE-P4 - names its pins here. -1 keeps the shared bus.
        config KVM_DISP_I2C_SDA_GPIO
            int "I2C OLED default SDA GPIO (-1 = the capture chip's bus)"
            depends on KVM_ENABLE_DISPLAY
            range -1 ENV_GPIO_RANGE_MAX
            default -1

        config KVM_DISP_I2C_SCL_GPIO
            int "I2C OLED default SCL GPIO (-1 = the capture chip's bus)"
            depends on KVM_ENABLE_DISPLAY
            range -1 ENV_GPIO_RANGE_MAX
            default -1

        # The ATX pins are offered the same way, and for the same reason: which
        # pins are free differs per board. They are kept clear of the display's
        # defaults above, because a device wearing both is the ordinary case and
        # the firmware refuses a pin claimed twice - overlapping defaults would
        # put a new owner in an argument the first time they touch one.
        config KVM_ATX_PWR_GPIO
            int "ATX power button default GPIO"
            depends on KVM_ENABLE_ATX
            range -1 ENV_GPIO_RANGE_MAX
            default 46

        config KVM_ATX_RST_GPIO
            int "ATX reset button default GPIO"
            depends on KVM_ENABLE_ATX
            range -1 ENV_GPIO_RANGE_MAX
            default 47

        # The LED is the one of the three that stays unassigned by default. It is
        # the optional wire - a relay board cannot sense it at all - and the input
        # is biased toward "off", so a pin nobody wired would report the target as
        # powered down for ever. No reading is better than a wrong one. GPIO 48 is
        # free for it on every board but the Guition, where 3 is.
        config KVM_ATX_LED_GPIO
            int "ATX power LED sense default GPIO (-1 to leave unassigned)"
            depends on KVM_ENABLE_ATX
            range -1 ENV_GPIO_RANGE_MAX
            default -1

        config KVM_ENABLE_HTTPS
            bool "HTTPS and authentication"
            default y
            help
                Serve the web interface over TLS with a self-signed certificate
                generated on first boot, and require a login. Disable only for a
                trusted network or when the device sits behind a VPN.
    endmenu

    menu "Video capture"
        config KVM_TC358743_RST_GPIO
            int "TC358743 RESETN GPIO (active low; -1 if unused)"
            range -1 ENV_GPIO_RANGE_MAX
            default 23

        config KVM_BRIDGE_RST_ACTIVE_HIGH
            bool "The capture bridge's reset line is active high"
            default n
            help
                The TC358743's line is RESETN: held low to reset, released high to
                run, which is the default here. M5Stack's Add-on Display In wires
                its LT6911D the other way round - drive that pin high and the
                bridge stays in reset and never answers I2C at all.

        config KVM_BRIDGE_INT_GPIO
            int "The capture bridge's mode-change interrupt GPIO (-1 if not wired)"
            range -1 ENV_GPIO_RANGE_MAX
            default -1
            help
                A pin the bridge pulses when the source changes resolution. The
                M5Stack Add-on Display In wires the LT6911D's INTIO to G38: a
                200 ms high pulse on every change. With it the mode is read
                again at once instead of at the next 200 ms poll.

        config KVM_LT6911
            bool "LT6911D capture bridge (M5Stack Add-on Display In)"
            default n
            help
                M5Stack's Add-on Display In. The chip raises its own lanes as
                soon as it locks to HDMI - nothing here programs its output -
                so this driver only finds it, reads its ID, and reads back the
                mode it has measured, which follows the source on its own.

                It opens the chip's register bus for one access at a time. Left
                open, the bridge's own firmware is held off its registers and
                the HDMI side goes down, which looks exactly like a chip that
                never transmits.


        config KVM_MIPI_LANE_MBPS
            int "CSI lane rate (Mbit/s per lane)"
            range 100 1500
            default 972
            help
                What the capture bridge puts on each MIPI lane. The TC358743 is
                driven at 972 by this firmware; an LT6911D picks its own and
                Lontium's numbers are 714 at 720p60 and 1308 at 1080p60.

        config KVM_TC358743_REFCLK_HZ
            int "TC358743 reference clock (Hz)"
            default 27000000
            help
                The crystal fitted on the capture board. The Geekworm C790 uses
                27 MHz; change it only for a board with a different clock.

        config KVM_JPEG_QUALITY
            int "Default JPEG quality 1-100"
            range 1 100
            default 70

        config KVM_TC358743_ADV_DEBUG
            bool "Advanced TC358743 debugging (verbose stall / bridge logs + extra I2C reads)"
            default n
            help
                When enabled, CSI frame timeouts log extra TC358743 register state, AVI
                infoframe dumps, and periodic bridge status. Adds I2C traffic on error paths.
                Boot-time SYS_STATUS lines from init are unchanged.
    endmenu

    menu "Board pins"
        comment "Defaults are for the Waveshare ESP32-P4-ETH."
        comment "Change these, and the Ethernet pins under Network, to port to another board."

        choice KVM_BOARD
            prompt "Which board this image is for"
            default KVM_BOARD_WAVESHARE_ETH
            help
                Names the board and picks its expansion header layout, which is
                what the console's Pins tab draws so an operator can see where a
                wire actually goes. Everything else about a board is the pins
                below; this only decides what to call it and which header it has.

                A board whose header is not described here still works - the Pins
                tab just falls back to listing every usable GPIO.

            config KVM_BOARD_WAVESHARE_ETH
                bool "Waveshare ESP32-P4-ETH"
            config KVM_BOARD_WAVESHARE_POE
                bool "Waveshare ESP32-P4-WIFI6-POE-ETH"
            config KVM_BOARD_WAVESHARE_WIFI6_DEVKIT
                bool "Waveshare ESP32-P4-WIFI6-DEV-KIT"
            config KVM_BOARD_WAVESHARE_MODULE_DEVKIT
                bool "Waveshare ESP32-P4-Module-DEV-KIT"
            config KVM_BOARD_WAVESHARE_WIFI6
                bool "Waveshare ESP32-P4-WIFI6"
            config KVM_BOARD_WAVESHARE_NANO
                bool "Waveshare ESP32-P4-NANO"
            config KVM_BOARD_WAVESHARE_NANO_WIFI6_DB
                bool "Waveshare ESP32-P4-NANO-WIFI6-DB"
            config KVM_BOARD_FIREBEETLE2_P4
                bool "DFRobot FireBeetle 2 ESP32-P4"
            config KVM_BOARD_VIEWE_P4_PI
                bool "VIEWE ESP32-P4-Pi"
            config KVM_BOARD_GUITION
                bool "Guition ESP32-P4-M3-Dev"
            config KVM_BOARD_FUNCEV
                bool "Espressif ESP32-P4 Function EV"
            config KVM_BOARD_M5_POE_P4
                bool "M5Stack Unit PoE-P4"
            config KVM_BOARD_OTHER
                bool "Something else"
        endchoice

        config KVM_I2C_SDA_GPIO
            int "TC358743 I2C SDA"
            range ENV_GPIO_RANGE_MIN ENV_GPIO_RANGE_MAX
            default 7

        config KVM_I2C_SCL_GPIO
            int "TC358743 I2C SCL"
            range ENV_GPIO_RANGE_MIN ENV_GPIO_RANGE_MAX
            default 8

        config KVM_BUTTON_GPIO
            int "BOOT button GPIO for password reset (-1 if none)"
            range -1 ENV_GPIO_RANGE_MAX
            default 35
            help
                Held at start-up it clears a forgotten password. Set to -1 on a
                board with no reachable button; the reset feature is then off.

        config KVM_SD_CLK_GPIO
            int "microSD CLK"
            range ENV_GPIO_RANGE_MIN ENV_GPIO_RANGE_MAX
            default 43

        config KVM_SD_CMD_GPIO
            int "microSD CMD"
            range ENV_GPIO_RANGE_MIN ENV_GPIO_RANGE_MAX
            default 44

        config KVM_SD_D0_GPIO
            int "microSD D0"
            range ENV_GPIO_RANGE_MIN ENV_GPIO_RANGE_MAX
            default 39

        config KVM_SD_D1_GPIO
            int "microSD D1"
            range ENV_GPIO_RANGE_MIN ENV_GPIO_RANGE_MAX
            default 40

        config KVM_SD_D2_GPIO
            int "microSD D2"
            range ENV_GPIO_RANGE_MIN ENV_GPIO_RANGE_MAX
            default 41

        config KVM_SD_D3_GPIO
            int "microSD D3"
            range ENV_GPIO_RANGE_MIN ENV_GPIO_RANGE_MAX
            default 42

        config KVM_SD_CD_GPIO
            int "microSD card-detect GPIO (-1 if not wired)"
            range -1 ENV_GPIO_RANGE_MAX
            default -1
            help
                The slot's card-detect switch. With it a card pushed in or pulled
                out is noticed at once rather than at the next five-second check,
                and an empty slot is not tried. The M5Stack Add-on Display In
                wires it to G37.

        config KVM_SD_CD_ACTIVE_HIGH
            bool "Card detect reads high with a card in"
            depends on KVM_SD_CD_GPIO >= 0
            default n
            help
                Off for the usual switch that pulls the line low when a card is
                in. The M5Stack Add-on Display In reads high with a card in
                (measured on the board).

        config KVM_SD_PWR_GPIO
            int "microSD slot power-gate GPIO (-1 if always powered)"
            range -1 ENV_GPIO_RANGE_MAX
            default 45
            help
                Gates 3.3 V to the card. Set to -1 on a board whose slot is
                always powered; the firmware then does not touch a power pin.

        config KVM_SD_PWR_ACTIVE_LOW
            bool "microSD power-gate is active-low"
            default y
            depends on KVM_SD_PWR_GPIO >= 0

        config KVM_SD_IO_LDO_CHAN
            int "On-chip LDO that powers the microSD IO pins (-1 if none)"
            range -1 4
            default -1 if KVM_BOARD_M5_POE_P4 || KVM_BOARD_OTHER
            default 4
            help
                The ESP32-P4 LDO channel wired to the slot's IO supply, if any.
                Every supported board with a microSD slot powers VDD_IO_5 and the
                card's pull-ups from LDO_VO4, so 4 (read off each vendor's
                schematic; checked on hardware on the Function EV and the P4-ETH).
                Without it on, the card only reads at a low clock, and on pre-3.0
                chips does not write at all. -1 on the M5Stack Unit PoE-P4, whose
                card is on an add-on wired to other pins, and on unknown boards.

        config KVM_SD_WRITE_NO_LDO
            bool "This slot writes reliably without the on-chip IO LDO"
            default y if KVM_BOARD_M5_POE_P4
            default n
            help
                Below chip revision 3.0 the microSD is read-only unless the
                slot's IO rail is fed by the P4's own LDO, because writes time
                out otherwise. That ties the two together, and on a board whose
                slot is fed from somewhere else the tie is wrong rather than
                safe: the M5Stack add-on's card mounts at the full 40 MHz with
                no bus errors and nothing here powers its rail. Turn this on
                only for a board where that has been checked on hardware.

        config KVM_SD_MAX_KHZ
            int "Fastest microSD clock to try, kHz"
            range 2000 40000
            default 40000 if KVM_SD_IO_LDO_CHAN >= 0
            default 4000
            help
                The mount starts here and steps down (40, 20, 10, 4, 2 MHz) when
                the card fails to mount or to read; transfer errors later step
                it down again. The "microSD speed" setting overrides this.
    endmenu

    menu "Network"
        config KVM_ETH_ENABLE
            bool "Enable Ethernet (DHCP)"
            default y
            depends on SOC_EMAC_SUPPORTED

        config KVM_WIFI_SDIO_INTERNAL_PULLUP
            bool "Add the chip's internal pull-ups to the co-processor's SDIO lines"
            depends on KVM_WIFI
            default y if KVM_BOARD_WAVESHARE_WIFI6
            # No SDIO pull-ups at all on its schematic (DFR1172 V1.0).
            default y if KVM_BOARD_FIREBEETLE2_P4
            # The same 51k as the WIFI6 on their schematics (2026-10-02 audit):
            # the ESP32-P4-Module (DEV-KIT, and the WIFI6-DEV-KIT built on the
            # same design), the VIEWE P4-Pi core and the NANO-WIFI6-DB.
            default y if KVM_BOARD_WAVESHARE_MODULE_DEVKIT || KVM_BOARD_WAVESHARE_WIFI6_DEVKIT
            default y if KVM_BOARD_VIEWE_P4_PI || KVM_BOARD_WAVESHARE_NANO_WIFI6_DB
            default n
            help
                SDIO needs its lines pulled up, and Espressif ask for 10k on CMD
                and the data lines. The ESP32-P4-WIFI6 uses 51k, which is weak
                enough that a line climbs back to 3.3 V slowly - and the one that
                matters most is D1, because that is how the co-processor rings
                the doorbell for "I have data". Miss the doorbell and the link
                sits there: associated, addressed, and silent.

                The chip's own pull-ups are about 45k. In parallel with 51k that
                is roughly 24k, which is not the 10k a board should have had, but
                is twice what it has. Whether it is enough is a question for the
                board, not for us - so this is a switch, on by default only where
                the schematic says the resistors are weak.

                Costs nothing where the board is already correct; the internal
                pull-up simply sits in parallel with a stronger external one.

        config KVM_MDNS_HOSTNAME
            string "mDNS hostname (device is <name>.local)"
            default "espkvm"
            depends on KVM_ETH_ENABLE || KVM_WIFI
            help
                DNS label only: letters, digits, hyphen. Advertised over mDNS and
                sent as the DHCP client hostname when supported. It is shared by
                the Ethernet and WiFi transports.

                Not tied to Ethernet: a board with no wired port still answers to
                this name over WiFi, and it is also what the certificate and the
                device's own CA are named after.

        config KVM_ETH_RMII_CLK_GPIO
            int "RMII REFCLK GPIO (external input)"
            range ENV_GPIO_RANGE_MIN ENV_GPIO_RANGE_MAX
            default 50 if IDF_TARGET_ESP32P4
            default 0
            depends on KVM_ETH_ENABLE

        config KVM_ETH_RMII_TX_EN_GPIO
            int "RMII TX_EN"
            range ENV_GPIO_RANGE_MIN ENV_GPIO_OUT_RANGE_MAX
            default 49 if IDF_TARGET_ESP32P4
            default 0
            depends on KVM_ETH_ENABLE

        config KVM_ETH_RMII_TXD0_GPIO
            int "RMII TXD0"
            range ENV_GPIO_RANGE_MIN ENV_GPIO_OUT_RANGE_MAX
            default 34 if IDF_TARGET_ESP32P4
            default 0
            depends on KVM_ETH_ENABLE

        config KVM_ETH_RMII_TXD1_GPIO
            int "RMII TXD1"
            range ENV_GPIO_RANGE_MIN ENV_GPIO_OUT_RANGE_MAX
            default 35 if IDF_TARGET_ESP32P4
            default 0
            depends on KVM_ETH_ENABLE

        config KVM_ETH_RMII_CRS_DV_GPIO
            int "RMII CRS_DV"
            range ENV_GPIO_RANGE_MIN ENV_GPIO_IN_RANGE_MAX
            default 28 if IDF_TARGET_ESP32P4
            default 0
            depends on KVM_ETH_ENABLE

        config KVM_ETH_RMII_RXD0_GPIO
            int "RMII RXD0"
            range ENV_GPIO_RANGE_MIN ENV_GPIO_IN_RANGE_MAX
            default 29 if IDF_TARGET_ESP32P4
            default 0
            depends on KVM_ETH_ENABLE

        config KVM_ETH_RMII_RXD1_GPIO
            int "RMII RXD1"
            range ENV_GPIO_RANGE_MIN ENV_GPIO_IN_RANGE_MAX
            default 30 if IDF_TARGET_ESP32P4
            default 0
            depends on KVM_ETH_ENABLE

        config KVM_ETH_MDC_GPIO
            int "SMI MDC"
            range ENV_GPIO_RANGE_MIN ENV_GPIO_OUT_RANGE_MAX
            default 31 if IDF_TARGET_ESP32P4
            default 23
            depends on KVM_ETH_ENABLE

        config KVM_ETH_MDIO_GPIO
            int "SMI MDIO"
            range ENV_GPIO_RANGE_MIN ENV_GPIO_OUT_RANGE_MAX
            default 52 if IDF_TARGET_ESP32P4
            default 18
            depends on KVM_ETH_ENABLE

        config KVM_ETH_PHY_ADDR
            int "PHY address (-1 auto)"
            range -1 31
            default 1
            depends on KVM_ETH_ENABLE

        config KVM_ETH_PHY_RST_GPIO
            int "PHY reset GPIO (-1 none)"
            range -1 ENV_GPIO_OUT_RANGE_MAX
            default 51 if IDF_TARGET_ESP32P4
            default 5
            depends on KVM_ETH_ENABLE

        config KVM_WIFI
            bool "Enable WiFi (via an ESP32-C6 co-processor, esp-hosted/SDIO)"
            default n
            help
                The ESP32-P4 has no radio: WiFi comes from an onboard ESP32-C6
                running the esp-hosted slave firmware, reached over SDIO through
                esp_wifi_remote. Only boards that carry a C6 - e.g. the Espressif
                ESP32-P4 Function EV board - can use it; the Waveshare ESP32-P4-ETH
                has none, so this stays off by default and is set in a board
                overlay. Ethernet remains the primary link; WiFi is the fallback.
                Enabling it pulls in the esp_wifi_remote and esp_hosted components.

        config KVM_WIFI_COPROC_UPDATE
            bool "Carry a Wi-Fi co-processor image and offer to install it"
            depends on KVM_WIFI
            # Not for the C5 yet: esp-hosted-mcu's C5 builds from 2025-06 until
            # 3.x put the partition table at 0xc000, and an app built for 0x8000
            # would not find its partitions there. Nothing on the host can tell
            # which table a C5 has.
            default n if SLAVE_IDF_TARGET_ESP32C5
            # Off for now everywhere: the update itself works (tested on the
            # Function EV from its factory 0.0.22), but 3.0.9's aggregated SDIO
            # mode then stalled on "no slave credits" under video, while the
            # factory firmware ran clean once the host memory fixes were in.
            default n
            help
                Embeds components/kvm_net/coproc/<chip>.bin (built by
                tools/build-coproc.sh from the same esp_hosted version as the
                host) and lets the console install it into the C6 or C5 over
                SDIO. Boards ship their co-processor with whatever esp-hosted
                the maker flashed, sometimes an early one with only the slow
                SDIO mode. Adds about 1.2 MB to the image.
    endmenu

    menu "Updates"
        config KVM_UPDATE_URL
            string "Default update manifest URL"
            default "https://fw.espkvm.io/firmware/manifest.json"
            help
                The default value of the runtime "Update manifest" setting - the
                manifest.json the console's update check reads. Per board, because
                each board has its own build: the root path serves the Waveshare
                image (and older devices that predate the per-board layout), and
                other boards point at firmware/<board>/manifest.json. A user can
                still override it at runtime to a fork or an in-network mirror.
    endmenu

endmenu
```
